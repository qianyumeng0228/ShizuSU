## kernel/Kconfig
```kconfig
menu "KernelSU"

config KSU
	tristate "KernelSU function support"
	depends on KPROBES && EXT4_FS
	default y
	help
	  Enable kernel-level root privileges on Android System.
	  Requires CONFIG_KPROBES for kernel hooking support.
	  Requires CONFIG_EXT4_FS for `ext4_unregister_sysfs`.
	  To compile as a module, choose M here: the
	  module will be called kernelsu.

config KSU_DEBUG
	bool "KernelSU debug mode"
	depends on KSU
	default n
	help
	  Enable KernelSU debug mode.

config KSU_MANUAL_SU
    bool "Use manual su"
    depends on KSU
    default y
    help
      Use manual su and authorize the corresponding command line and application via prctl

config KPM
    bool "Enable SukiSU KPM"
    depends on KSU && 64BIT
    default n
    help
      Enabling this option will activate the KPM feature of SukiSU.
      This option is suitable for scenarios where you need to force KPM to be enabled.
      but it may affect system stability.
    select KALLSYMS
    select KALLSYMS_ALL

config KSU_DISABLE_MANAGER
	bool "Disable KernelSU manager integration"
	depends on KSU
	default n
	help
	  Disable manager APK detection and manager-specific handling.
	  Root will be used in place of manager-only functionality.

config KSU_DISABLE_POLICY
	bool "Disable KernelSU policy profiles"
	depends on KSU
	default n
	help
	  Disable per-app root/non-root profile customization.
	  Escalation will always use the default full root profile, and
	  non-root handling will follow the global umount policy only.

config KSU_X86_PATCH_SYSCALL_DISPATCHER
	bool "Dynamically patch x64's hardened syscall dispatcher to support syscall hooks"
	depends on KSU && X86_64
	default n
	help
	  Dynamically patch x64's hardened syscall dispatcher to support syscall hooks. This is a
	  replacement for a kernel source code patch, and is useful for x86_64 LKM mode.

# [ShizuSU 补丁1] 多管理器兼容（自研开关；上游 ReSukiSU 无此 Kconfig，见清单 D3）
config KSU_MULTI_MANAGER_SUPPORT
	bool "ShizuSU multi-manager support"
	depends on KSU
	default y
	help
	  Trust a built-in multi-signature table (official / RKSU / WKSU / KowSU / KSUN / MKSU
	  plus the ShizuSU-injected key) as the single manager trust root, instead of a single
	  hardcoded signing certificate.

config KSU_DYNAMIC_MANAGER
	bool "ShizuSU dynamic manager hot-register channel"
	depends on KSU && KSU_MULTI_MANAGER_SUPPORT
	default y
	help
	  Allow root or the currently-crowned manager to hot-register a new manager APK via
	  ioctl('K',107), with persistence to /data/adb/shizusu/manager. Safe to disable.

# [ShizuSU 补丁2] 内核隐身（移植自 7kimisu v2.29 kernel/manager/stealth.c；上游无独立 Kconfig）
config KSU_STEALTH
	bool "ShizuSU kernel stealth mode"
	depends on KSU
	default y
	help
	  When the stealth switch is on, GET_INFO stops reporting KSU_GET_INFO_FLAG_MANAGER so
	  the manager app looks "not installed". Real kernel permission checks and the crowned
	  manager are unchanged, so the manager (or root) can always toggle it back. State is
	  persisted at /data/adb/shizusu/stealth and reloaded on POST_FS_DATA. Disable to remove
	  the stealth ioctl(25/26) and the suppression logic entirely.

# [ShizuSU 补丁4] KPROBES 钩子隐藏（[自研] 开关；Next Kconfig 无此选项，见 notes/next.md §8.5）。
# 最高风险项：KPROBES 与 KPM 共用 ftrace/kprobe/tracepoint 槽位，二者同时开启会抢钩子位。
# 默认关，KPM 共存编译/运行验证通过前不得打开（清单 4.2 / T4）。
config KSU_KPROBES_HIDE
	bool "ShizuSU KPROBES hook hiding (HIGH RISK, default off)"
	depends on KSU
	default n
	help
	  Expose the kprobes-based syscall-hook hiding backend and the GET_HOOK_MODE(98)
	  reporting surface to the manager app.

	  RISK: this shares ftrace/kprobe/tracepoint slots with CONFIG_KPM. Turning both on is
	  UNVERIFIED (待实测) and may fail to load or destabilize the kernel. Keep this OFF until
	  the KPM coexistence matrix is validated on the target device. When off (default), the
	  syscall hook backend is selected by CONFIG_HAVE_SYSCALL_TRACEPOINTS exactly as upstream,
	  and GET_HOOK_MODE reports the actually-active backend.

endmenu
```
